/*
 * Copyright (c) 2026 Tenstorrent AI ULC
 *
 * SPDX-License-Identifier: Apache-2.0
 */

#include <tenstorrent/tt_mimir_gddr.dtsi>

/* BL1 starts 256KB from the end of SRAM; text+data fit in the first 64KB.
 * The window stops short of vuart_ram so the console buffer is left alone.
 */
&ram0 {
	reg = <0x0 0xc011b000 0x0 0x3d000>;
};

/* First stage to run on Mimir, so it puts the persistent vuart into a known state */
&vuart0 {
	init-metadata;
};

&{/soc} {
	/* Mimir SPA view of Keraunos' mbox0: writing even channel x (outbound)
	 * here triggers Keraunos's RX on its inbound channel x+1. No local
	 * interrupt line exists for this remote view, so interrupts are
	 * omitted.
	 */
	k_mbox: mbox@1202018000 {
		compatible = "tenstorrent,grendel-mbox";
		reg = <0x12 0x02018000 0x0 0x20000>;
		channel-pairs = <32>;
		#mbox-cells = <1>;
	};
};
